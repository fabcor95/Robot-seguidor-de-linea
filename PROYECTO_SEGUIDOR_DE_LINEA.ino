
float value = 0; //ESTE COMANDO SIRVE PARA DECLARAR UNA 
//VARIABLE FLOTANTE value QUE EMPIEZA EN 0 Y VA A SERVIR PARA 
//LEER EL PRIMER SENSOR CNY70 DE LA TERMINAL A0 DEL ARDUINO

float value2=0; //ESTE COMANDO SIRVE PARA DECLARAR UNA 
//VARIABLE FLOTANTE value2 QUE EMPIEZA EN 0 Y VA A SERVIR PARA 
//LEER EL SEGUNDO SENSOR CNY70 DE LA TERMINAL A1 DEL ARDUINO

float voltaje_derecho; //ESTE COMANDO SIRVE PARA DECLARAR UNA 
//VARIABLE FLOTANTE voltaje_derecho QUE NO EMPIEZA CON UN 
//VALOR PORQUE VA A SERVIR PARA CONVERTIR LOS VALORES DE 
//LA VARIABLE value (0-1023) A VALORES DE VOLTAJE DE 0-5V 
//CON EL FIN DE MANEJAR LOS VOLTAJES EN TODAS LAS CONDICIONES
//DEL SEGUIDOR DE LÍNEA

float voltaje_izquierdo; //ESTE COMANDO SIRVE PARA DECLARAR UNA 
//VARIABLE FLOTANTE voltaje_derecho QUE NO EMPIEZA CON UN 
//VALOR PORQUE VA A SERVIR PARA CONVERTIR LOS VALORES DE 
//LA VARIABLE value2 (0-1023) A VALORES DE VOLTAJE DE 0-5V 
//CON EL FIN DE MANEJAR LOS VOLTAJES EN TODAS LAS CONDICIONES
//DEL SEGUIDOR DE LÍNEA

int motor_der=11; //ESTE COMANDO SIRVE PARA DECLARAR 
//UNA VARIABLE ENTERA motor_der ASIGNANDOLE EL VALOR DECIMAL 11
//PORQUE LUEGO SE VA A USAR ESE VALOR DECIMAL PARA CONVERTIRLO
//EN EL PIN 11 DEL PUERTO DIGITAL DEL ARDUINO.

int motor_izq=10; //ESTE COMANDO SIRVE PARA DECLARAR 
//UNA VARIABLE ENTERA motor_izq ASIGNANDOLE EL VALOR DECIMAL 10
//PORQUE LUEGO SE VA A USAR ESE VALOR DECIMAL PARA CONVERTIRLO
//EN EL PIN 10 DEL PUERTO DIGITAL DEL ARDUINO.

void setup()//ESTE ES EL INICIO DE CONFIGURACIÓN DE PUERTOS Y 
//MODULOS DE COMUNICACIÓN QUE SOLO SE HACE 1 VEZ

{
  Serial.begin (9600); //ESTE COMANDO SIRVE PARA INICIAR LA 
  //COMUNICACIÓN SERIAL CON LA COMPUTADORA A UNSA VELOCIDAD DE
  //9600 BITS/SEGUNDO
  
  pinMode (A0,INPUT);//ESTE COMANDO SIRVE PARA CONFIGURAR 
  //LA TERMINAL ANALÓGICA A0 DEL ARDUINO COMO ENTRADA PORQUE
  //AHÍ ES DONDE VA CONECTADO EL PRIMER SENSOR
  
  pinMode (A1,INPUT);//ESTE COMANDO SIRVE PARA CONFIGURAR 
  //LA TERMINAL ANALÓGICA A1 DEL ARDUINO COMO ENTRADA PORQUE
  //AHÍ ES DONDE VA CONECTADO EL SEGUNDO SENSOR
  
  pinMode (motor_der,OUTPUT); //ESTE COMANDO SIRVE PARA 
  //CONFIGURAR LA TERMINAL DIGITAL 11 DEL ARDUINO COMO SALIDA 
  //PORQUE AHÍ ES DONDE VA CONECTADO EL PRIMER MOTOR. ADEMÁS, 
  //EL CÓDIGO SABE QUE ES EL 11 PORQUE EL VALOR DE 
  //motor_der era 11
  
  pinMode (motor_izq,OUTPUT); //ESTE COMANDO SIRVE PARA CONFIGURAR 
  //LA TERMINAL DIGITAL 10 DEL ARDUINO COMO SALIDA PORQUE
  //AHÍ ES DONDE VA CONECTADO EL SEGUNDO MOTOR. ADEMÁS, EL CÓDIGO
  //SABE QUE ES EL 10 PORQUE EL VALOR DE motor_izq era 10
}

void loop() //ESTE ES EL CICLO LOOP QUE DICE QUE 
//MIENTRAS EL MICROCONTROLADOR SE ENCUENTRA ENERGIZADO, 
//SE VAN A EJECUTAR LAS INSTRUCCIONES QUE DICE ESTE COMANDO 
//POR TIEMPO INDEFINIDO HASTA QUE YA NO SE CUMPLA LA CONDICIÓN
{
 int x=0; //CON ESTE COMANDO SIRVE PARA DECLARAR UNA VARIABLE 
 // ENTERA X Y DARLE EL VALOR INICIAL DE 0 PORQUE ESA VARIABLE 
 //ES UNA VARIABLE AUXILIAR QUE ME VA A SERVIR CUANDO TENGA LA 
 //CONDICIÓN DE QUE LOS 2 SENSORES LEEN BLANCO
 
    value = analogRead(A0); //CON ESTE COMANDO SIRVE PARA GUARDAR
    //LA INFORMACIÓN DEL PRIMER SENSOR A LA VARIABLE value QUE 
    //ESTA CONECTADO A LA TERMINAL A0 DEL ARDUINO CON UN RANGO 
    //DE VALORES DE 0--1023.
    
    value2 = analogRead(A1);//CON ESTE COMANDO SIRVE PARA GUARDAR
    //LA INFORMACIÓN DEL SEGUNDO SENSOR A LA VARIABLE value2 QUE 
    //ESTA CONECTADO A LA TERMINAL A1 DEL ARDUINO CON UN RANGO 
    //DE VALORES DE 0--1023.
    
    voltaje_derecho=(value*(5))/1023; //CON ESTE COMANDO SIRVE 
    //PARA HACER UN PROCESO DE CONVERSIÓN DE LOS VALORES DE 0-1023
    //A LOS VALORES DE VOLTAJE DEL SENSOR DERECHO A 0-5VOLTS Y 
    //GUARDAR ESOS VALORES EN LA VARIABLE voltaje_derecho
    
    voltaje_izquierdo=(value2*(5))/1023;//CON ESTE COMANDO SIRVE 
    //PARA HACER UN PROCESO DE CONVERSIÓN DE LOS VALORES DE 0-1023
    //A LOS VALORES DE VOLTAJE DEL SENSOR IZQUIERDO A 0-5VOLTS Y 
    //GUARDAR ESOS VALORES EN LA VARIABLE voltaje_izquierdo
    
    Serial.print("PRRO El sensor derecho dice: ");//CON ESTE 
    //COMANDO SIRVE PARA IMPRIMIR TEXTO EN EL MONITOR SERIAL
    //PARA QUE LA COMPUTADORA ME AYUDE Y ME DIGA SI EL ARDUINO
    //ESTA LEYENDO EL SENSOR DERECHO
    
    Serial.println (voltaje_derecho,DEC); //CON ESTE 
    //COMANDO SIRVE PARA IMPRIMIR TEXTO EN EL MONITOR SERIAL
    //PARA QUE LA COMPUTADORA ME AYUDE Y ME DIGA SI EL ARDUINO
    //ESTA LEYENDO LOS SENSORES Y TAMBIÉN ME IMPRIME EL VALOR
    //QUE TIENE LA VARIABLE voltaje_derecho en formato decimal.
    
    Serial.print("PRRO El sensor izquierdo dice: ");//CON ESTE 
    //COMANDO SIRVE PARA IMPRIMIR TEXTO EN EL MONITOR SERIAL
    //PARA QUE LA COMPUTADORA ME AYUDE Y ME DIGA SI EL ARDUINO
    //ESTA LEYENDO EL SENSOR IZQUIERDO
    
    Serial.println (voltaje_izquierdo,DEC);//CON ESTE 
    //COMANDO SIRVE PARA IMPRIMIR TEXTO EN EL MONITOR SERIAL
    //PARA QUE LA COMPUTADORA ME AYUDE Y ME DIGA SI EL ARDUINO
    //ESTA LEYENDO LOS SENSORES Y TAMBIÉN ME IMPRIME EL VALOR
    //QUE TIENE LA VARIABLE voltaje_izquierdo en formato decimal.

    if(voltaje_derecho<0.7 && voltaje_izquierdo<0.7) //CON ESTE 
    //COMANDO SIRVE PARA HACER LA CONDICIÓN IF EN EL CUAL 
    //CONSISTE SI LA CONDICION ENCERRADA SE CUMPLE SE VAN A 
    //CUMPLIR TODAS LAS SENTENCIAS DE CONTROL QUE MARCAN ESTA 
    //CONDICIONANTE. LA CONDICIÓN ES SI cuando lee negro en 
    //ambos sensores, avanza recto
    {
      
      analogWrite(motor_der,63); //CON ESTE COMANDO SIRVE 
      //PARA USAR LA FUNCIÓN PWM EN EL ARDUINO Y LO QUE HACE 
      //ES DARLE EL VALOR ANALOGICO DE 255 EN FORMA DE VOLTAJE 
      //EN 5 VOLTS EN LA TERMINAL 11 DEL ARDUINO
      
      analogWrite(motor_izq,63); //CON ESTE COMANDO SIRVE 
      //PARA USAR LA FUNCIÓN PWM EN EL ARDUINO Y LO QUE HACE 
      //ES DARLE EL VALOR ANALOGICO DE 255 EN FORMA DE VOLTAJE 
      //EN 5 VOLTS EN LA TERMINAL 10 DEL ARDUINO
      }
   
   if(voltaje_derecho<0.7 && voltaje_izquierdo>0.7) //CON ESTE 
    //COMANDO SIRVE PARA HACER LA CONDICIÓN IF EN EL CUAL 
    //CONSISTE SI LA CONDICION ENCERRADA SE CUMPLE SE VAN A 
    //CUMPLIR TODAS LAS SENTENCIAS DE CONTROL QUE MARCAN ESTA 
    //CONDICIONANTE. LA CONDICIÓN ES SI cuando lee negro en el 
    //sensor derecho y blanco en el izquierdo
   {
      analogWrite(motor_der,63);//CON ESTE COMANDO SIRVE 
      //PARA USAR LA FUNCIÓN PWM EN EL ARDUINO Y LO QUE HACE 
      //ES DARLE EL VALOR ANALOGICO DE 21 EN FORMA DE VOLTAJE 
      //EN LA TERMINAL 11 DEL ARDUINO. Se mueve a la 
      //izquierda al mover el motor derecho
      
      analogWrite(motor_izq,0); // CON ESTE COMANDO SIRVE 
      //PARA USAR LA FUNCIÓN PWM EN EL ARDUINO Y LO QUE HACE 
      //ES DARLE EL VALOR ANALOGICO DE 8 EN FORMA DE VOLTAJE 
      //EN LA TERMINAL 10 DEL ARDUINO.
      
      x=2; //ultimo sensor que leyó negro fue izquierdo 
    }
    
   if(voltaje_derecho>0.7 && voltaje_izquierdo<0.7) ////CON ESTE 
    //COMANDO SIRVE PARA HACER LA CONDICIÓN IF EN EL CUAL 
    //CONSISTE SI LA CONDICION ENCERRADA SE CUMPLE SE VAN A 
    //CUMPLIR TODAS LAS SENTENCIAS DE CONTROL QUE MARCAN ESTA 
    //CONDICIONANTE. LA CONDICIÓN ES SI cuando lee negro en el 
    //izquierdo y blanco en derecho
   {
     

      analogWrite(motor_der,0);// CON ESTE COMANDO SIRVE 
      //PARA USAR LA FUNCIÓN PWM EN EL ARDUINO Y LO QUE HACE 
      //ES DARLE EL VALOR ANALOGICO DE 8 EN FORMA DE VOLTAJE 
      //EN LA TERMINAL 11 DEL ARDUINO. Se mueve a la derecha 
      //al mover el motor izquierdo.
      
      analogWrite(motor_izq,63); // CON ESTE COMANDO SIRVE 
      //PARA USAR LA FUNCIÓN PWM EN EL ARDUINO Y LO QUE HACE 
      //ES DARLE EL VALOR ANALOGICO DE 21 EN FORMA DE VOLTAJE 
      //EN LA TERMINAL 10 DEL ARDUINO. Se mueve a la derecha 
      //al mover el motor izquierdo.
      
      x=1; //ultimo sensor que leyó negro fue derecho
    }

    if(voltaje_derecho>0.7 && voltaje_izquierdo>0.7) //CON ESTE 
    //COMANDO SIRVE PARA HACER LA CONDICIÓN IF EN EL CUAL 
    //CONSISTE SI LA CONDICION ENCERRADA SE CUMPLE SE VAN A 
    //CUMPLIR TODAS LAS SENTENCIAS DE CONTROL QUE MARCAN ESTA 
    //CONDICIONANTE. LA CONDICIÓN ES SI cuando lee blanco en ambos sensores
    {
       if(x==1) //si el ultimo sensor que leyó negro fue el derecho entonces se salió por la izquierda.
       {
        

      analogWrite(motor_der,63); //CON ESTE COMANDO SIRVE 
      //PARA USAR LA FUNCIÓN PWM EN EL ARDUINO Y LO QUE HACE 
      //ES DARLE EL VALOR ANALOGICO DE 21 EN FORMA DE VOLTAJE 
      //EN LA TERMINAL 11 DEL ARDUINO.                 
          analogWrite(motor_izq,0); // CON ESTE COMANDO SIRVE 
      //PARA USAR LA FUNCIÓN PWM EN EL ARDUINO Y LO QUE HACE 
      //ES DARLE EL VALOR ANALOGICO DE 8 EN FORMA DE VOLTAJE 
      //EN LA TERMINAL 10 DEL ARDUINO moverse a la izquierda al 
      //activar el motor derecho
          
        }
        if(x==2) //si el ultimo sensor que leyó negro fue el izquierdo entonces se salió por la derecha 
        {
          analogWrite(motor_der,0); // CON ESTE COMANDO SIRVE 
      //PARA USAR LA FUNCIÓN PWM EN EL ARDUINO Y LO QUE HACE 
      //ES DARLE EL VALOR ANALOGICO DE 8 EN FORMA DE VOLTAJE 
      //EN LA TERMINAL 11 DEL ARDUINO. Se mueve a la derecha 
      //al mover el motor izquierdo
      
        analogWrite(motor_izq,63); // CON ESTE COMANDO SIRVE 
      //PARA USAR LA FUNCIÓN PWM EN EL ARDUINO Y LO QUE HACE 
      //ES DARLE EL VALOR ANALOGICO DE 23 EN FORMA DE VOLTAJE 
      //EN LA TERMINAL 10 DEL ARDUINO.
          }
      
      
      }
    
    
}//FIN DEL LOO

